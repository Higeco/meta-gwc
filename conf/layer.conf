## conf/layer.conf
```bitbake
# We have a conf and classes directory, add to BBPATH
BBPATH .= ":${LAYERDIR}"

# We have recipes-* directories, add to BBFILES
BBFILES += " \
	${LAYERDIR}/recipes/*/*.bb \
	${LAYERDIR}/recipes/*/*.bbappend \
	${LAYERDIR}/recipes-*/*/*.bb \
	${LAYERDIR}/recipes-*/*/*.bbappend \
	"

BBFILE_COLLECTIONS += "gwc"
BBFILE_PATTERN_gwc = "^${LAYERDIR}/"
BBFILE_PRIORITY_gwc = "6"

LAYERDEPENDS_gwc = "core openembedded-layer networking-layer"
LAYERSERIES_COMPAT_gwc = "dunfell"
```
